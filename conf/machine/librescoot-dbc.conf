## conf/machine/librescoot-dbc.conf
```bitbake
#@TYPE: Machine
##@NAME: NXP i.MX6DL SABRE Smart Device
##@SOC: i.MX6DL
##@DESCRIPTION: Machine configuration for NXP i.MX6DL SABRE Smart Device
##@MAINTAINER: Otavio Salvador <otavio@ossystems.com.br>

MACHINEOVERRIDES =. "mx6:mx6dl:"

require conf/machine/include/imx6sabresd-common.inc
KERNEL_DEVICETREE = " librescoot-dbc.dtb"
### u-boot-imx settings ###

# The u-boot-imx does not provide SPL support
SPL_BINARY:pn-u-boot-imx = ""
UBOOT_MACHINE = "mx6solosabresd_config"
UBOOT_MAKE_TARGET = "all"
UBOOT_SUFFIX = "imx"

# WKS_FILE = "sdimage-librescoot-dbc.wks"

MACHINE_FIRMWARE += "firmware-imx-epdc"

IMAGE_INSTALL:append = " kernel-devicetree kernel-image-zimage"
MACHINE_EXTRA_RRECOMMENDS = "kernel-modules"
MACHINE_FEATURES = "usbgadget usbhost vfat"

MENDER_STORAGE_DEVICE = "/dev/mmcblk3"
MENDER_UBOOT_STORAGE_DEVICE = "2"

MENDER_DATA_PART_FSTYPE = "ext4"
MENDER_IMAGE_BOOTLOADER_FILE = "u-boot.imx"

MENDER_BOOT_PART = "/dev/mmcblk3p1"
MENDER_ROOTFS_PART_A = "/dev/mmcblk3p2"
MENDER_ROOTFS_PART_B = "/dev/mmcblk3p3"
MENDER_DATA_PART = "/dev/mmcblk3p4"

MENDER_BOOT_PART_SIZE_MB = "32"
MENDER_DATA_PART_SIZE_MB = "256"
MENDER_STORAGE_TOTAL_SIZE_MB = "2368"

MENDER_FEATURES_ENABLE:append = " mender-uboot mender-image-sd"
MENDER_FEATURES_DISABLE:append = " mender-grub mender-image-uefi"
```

## scripts/lib/wic/canned-wks/sdimage-librescoot-dbc.wks
```
part u-boot --source rawcopy --sourceparams="file=u-boot-dtb.imx" --ondisk mmcblk --no-table --align 1
part /boot --source bootimg-partition --ondisk mmcblk --fstype=vfat --label boot --align 4096 --size 32M
part / --source rootfs --ondisk mmcblk --fstype=ext4 --label rootfs-A --align 4096 --size 1536M
part --source rootfs --ondisk mmcblk --fstype=ext4 --label rootfs-B --align 4096 --size 1536M
part /data --ondisk mmcblk --fstype=ext4 --label data --align 4096 --size 256M
```
